## boards/shields/antari/Kconfig.defconfig
```kconfig
# Copyright (c) 2020 The ZMK Contributors
# SPDX-License-Identifier: MIT

if SHIELD_ANTARI

config ZMK_KEYBOARD_NAME
    default "antari"

endif # SHIELD_ANTARI
```

## boards/shields/antari/Kconfig.shield
```kconfig
# Copyright (c) 2020 The ZMK Contributors
# SPDX-License-Identifier: MIT

config SHIELD_ANTARI
    def_bool $(shields_list_contains,antari)
```
